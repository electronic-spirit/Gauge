
#include "Display.h"
#include "u8g2_LCD.h"


uint8_t screen = Main_screen;
u8g2_t u8g2;
uint8_t edit_param=0;
SPI_HandleTypeDef hspi2;

// Заглавная картинка
const uint8_t img1[]={
0,208,0,38,
0x00, 0x00, 0x00, 0x00, 0x00, 0x00, 0x00, 0xC0, 0x00, 0x00, 0x00, 0x00,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 0x00
};

// Картинка выключения
const uint8_t img2[]={
0,240,0,160,
0x00, 0x00, 0x00, 0x00, 0x00, 0x00, 0x00, 0x00, 0x00, 0x00, 0x00, 0x80,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 0x00
};

const char *PGA_name[9]={ "PGA OFF", "PGA 1", "PGA 2", "PGA 4", "PGA 8", "PGA 16", "PGA 32", "PGA 64", "PGA 128" };



void DrawImage(const uint8_t *image, uint16_t x, uint16_t y, uint8_t inverse)
{
	uint16_t xi = 0, yi = 0, bitnum=0;
	uint8_t color;
	uint16_t SIZE_X, SIZE_Y;
	// Размер картинки
	SIZE_X = (uint16_t)(((image[0]<<8) + image[1])>>3);
	SIZE_Y = (uint16_t)(image[2]<<8) + image[3];
	for(yi = 0; yi < SIZE_Y; yi++)
	{
		for(xi = 0; xi < SIZE_X; xi++)
		{
			for(bitnum=0;bitnum<8;bitnum++)
			{
				color=((image[xi+yi*SIZE_X+4])>>(7-bitnum))&0x01;
				if(color==inverse)u8g2_DrawPixel(&u8g2, x+(xi*8)+bitnum, y+yi);
			}
		}
	}
}










void Display_init(void)
{
	uint8_t aTxBuffer[4], aRxBuffer[4];
	u8g2_Setup_uc1638_240x160_f(&u8g2, U8G2_R0, u8x8_byte_4wire_hw_spi, u8x8_gpio_and_delay_cb_stm32l4);
	u8g2_InitDisplay(&u8g2);
	u8g2_SetPowerSave(&u8g2, 0);
	u8g2_ClearDisplay(&u8g2);
	u8g2_SetFont(&u8g2, u8g2_font_10x20_t_cyrillic);

	//Подсветка
	temp_light=display_brightness;
	TIM2->CCR1=display_brightness;

	// Контрастность
	HAL_GPIO_WritePin(LCD_CD_GPIO_Port, LCD_CD_Pin, GPIO_PIN_RESET);
	HAL_GPIO_WritePin(LCD_CS_GPIO_Port, LCD_CS_Pin, GPIO_PIN_RESET);
	aTxBuffer[0]=0xE8+1;
	HAL_SPI_TransmitReceive(&hspi2, (uint8_t*)aTxBuffer, (uint8_t *)aRxBuffer, 1, 1000);
	HAL_GPIO_WritePin(LCD_CS_GPIO_Port, LCD_CS_Pin, GPIO_PIN_SET);
	HAL_GPIO_WritePin(LCD_CS_GPIO_Port, LCD_CS_Pin, GPIO_PIN_RESET);
	aTxBuffer[0]=0x81;
	HAL_SPI_TransmitReceive(&hspi2, (uint8_t*)aTxBuffer, (uint8_t *)aRxBuffer, 1, 1000);
	HAL_GPIO_WritePin(LCD_CD_GPIO_Port, LCD_CD_Pin, GPIO_PIN_SET);
	aTxBuffer[0]=display_contrast+125;
	HAL_SPI_TransmitReceive(&hspi2, (uint8_t*)aTxBuffer, (uint8_t *)aRxBuffer, 1, 1000);
	HAL_GPIO_WritePin(LCD_CS_GPIO_Port, LCD_CS_Pin, GPIO_PIN_SET);

	DrawImage(img1, 16, 61, 1);
	// Рисуем
	u8g2_SendBuffer(&u8g2);
	u8g2_ClearBuffer(&u8g2);
}



void Gauge_loading(uint8_t*text, uint8_t percent)
{
	DrawImage(img1, 16, 61, 1);

	u8g2_DrawFrame(&u8g2, 40, 120, 160, 12);
	u8g2_DrawBox(&u8g2, 40,120, percent*1.6, 12);

	//sprintf(RAM,"%d", percent);
	//u8g2_DrawUTF8(&u8g2, 50, 120, RAM);
	u8g2_SetFont(&u8g2, u8g2_font_8x13_t_cyrillic);
	u8g2_DrawUTF8(&u8g2, 40, 145, (char *)text);

	// Рисуем
	u8g2_SendBuffer(&u8g2);
	u8g2_ClearBuffer(&u8g2);
}




void Off_screen_func(void)
{
	// static
	if(old_active_string==0xFF)
	{
		DrawImage(img2, 0, 0, 0);
		// Рисуем
		u8g2_SendBuffer(&u8g2);
		u8g2_ClearBuffer(&u8g2);
		old_active_string=0;
	}
}

uint16_t blink_timer=0;
uint8_t blink_trig=0;
void Blink_Edit_Parameter_timer(void)
{
	if(++blink_timer==200)blink_trig=1;
	if(blink_timer>=500){blink_timer=blink_trig=0;}
}


void Blink_Edit_Parameter(uint8_t x, uint8_t y, const char* text, uint8_t param_num, uint8_t curr_param)
{
	if(param_num==curr_param)
	{if(blink_trig==1)u8g2_DrawUTF8(&u8g2, x, y, text);}
	else u8g2_DrawUTF8(&u8g2, x, y, text);
}


void Test_screen_func(void)
{
	uint8_t i=0;
	u8g2_SetFont(&u8g2, u8g2_font_10x20_t_cyrillic);

	// Индикация напряжения
	for(i=0;i<6;i++)
	{
		sprintf((char *)RAM,"%+fmV", ADC_volt[i]);
		u8g2_DrawUTF8(&u8g2, 120, 30+i*15, (char *)RAM);
	}

	// Индикация АЦП
	for(i=0;i<7;i++)
	{
		//sprintf(RAM,"%d %+d", i, ADC_channel_0[i]);
		sprintf((char *)RAM,"%d %+d", i, ADC_middle[i]);
		u8g2_DrawUTF8(&u8g2, 5, 30+i*15, (char *)RAM);
	}

	switch(adc_calibration_mode)
	{
		case 0: u8g2_DrawUTF8(&u8g2, 5, 140, "SC"); break;
		case 1: u8g2_DrawUTF8(&u8g2, 5, 140, "OC"); break;
		case 2: u8g2_DrawUTF8(&u8g2, 5, 140, "FSC"); break;
	}

	// �?ндикация PGA
	u8g2_DrawUTF8(&u8g2, 5, 155, PGA_name[PGA_GAIN[0]]);

	sprintf((char *)RAM,"%f", Kdiv);
	u8g2_DrawUTF8(&u8g2, 120, 155, (char *)RAM);

	// Рисуем
	u8g2_SendBuffer(&u8g2);
	u8g2_ClearBuffer(&u8g2);
}




void Display_process(void)
{
	switch(screen)
	{
		case Main_screen: Main_screen_func(); break;
		case Test_screen: Test_screen_func(); break;
		case Off_screen: Off_screen_func(); break;
		case Option_screen: Option_screen_func(); break;
		case Display_options_screen: Display_options_screen_func(); break;
		case ADC_options_screen: ADC_options_screen_func(); break;
		case Measure_options_screen: Measure_options_screen_func(); break;
		case Parameter_screen: Parameter_screen_func(); break;
		case RTC_screen: RTC_screen_func(); break;
		case Auto_Off_option_screen: Auto_Off_option_screen_func(); break;
		case About_options_screen: About_options_screen_func(); break;
		case Logging_options_screen: Logging_options_screen_func(); break;
	}
	sleep(10);
}

